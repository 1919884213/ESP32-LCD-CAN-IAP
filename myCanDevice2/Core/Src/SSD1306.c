#include "SSD1306.h"
#include <string.h>

/*==========================================================================
 * SSD1306 128x64 OLED 软件 I2C 驱动
 * 通过 PA7(SDA)/PB0(SCK) 开漏位翻转模拟 I2C。
 * 内部维护 1024 字节页缓冲, SSD1306_UpdateScreen() 一次性刷屏。
 *========================================================================*/

#define SSD1306_BUFFER_SIZE (SSD1306_WIDTH * SSD1306_HEIGHT / 8)

static uint8_t s_buffer[SSD1306_BUFFER_SIZE];

/* 软件 I2C 引脚宏 (开漏输出, 释放=高, 拉低=低) */
#define SDA_H() HAL_GPIO_WritePin(LED_SDA_GPIO_Port, LED_SDA_Pin, GPIO_PIN_SET)
#define SDA_L()                                                                \
  HAL_GPIO_WritePin(LED_SDA_GPIO_Port, LED_SDA_Pin, GPIO_PIN_RESET)
#define SCK_H() HAL_GPIO_WritePin(LED_SCK_GPIO_Port, LED_SCK_Pin, GPIO_PIN_SET)
#define SCK_L()                                                                \
  HAL_GPIO_WritePin(LED_SCK_GPIO_Port, LED_SCK_Pin, GPIO_PIN_RESET)

/* 半位周期延时 (约 5us -> I2C 约 100kHz 慢速, 稳定可靠) */
static void I2C_Delay(void) {
  volatile uint32_t i;
  for (i = 0; i < 40; i++) {
    __NOP();
  }
}

/* I2C 起始条件 */
static void I2C_Start(void) {
  SDA_H();
  SCK_H();
  I2C_Delay();
  SDA_L();
  I2C_Delay();
  SCK_L();
  I2C_Delay();
}

/* I2C 停止条件 */
static void I2C_Stop(void) {
  SDA_L();
  SCK_H();
  I2C_Delay();
  SDA_H();
  I2C_Delay();
}

/* 发送一个字节, 返回 ACK 状态 (0=ACK, 1=NACK) */
static uint8_t I2C_WriteByte(uint8_t byte) {
  uint8_t ack;
  for (int i = 7; i >= 0; i--) {
    if (byte & (1 << i)) {
      SDA_H();
    } else {
      SDA_L();
    }
    SCK_H();
    I2C_Delay();
    SCK_L();
    I2C_Delay();
  }
  /* 第 9 个时钟: 释放 SDA 读 ACK。
     STM32 的 IDR 在输出模式下同样反映引脚实际电平,
     开漏+外部上拉时, 从机 ACK 会把 SDA 拉低 -> 读到 0 */
  SDA_H();
  SCK_H();
  I2C_Delay();
  ack = (HAL_GPIO_ReadPin(LED_SDA_GPIO_Port, LED_SDA_Pin) == GPIO_PIN_SET) ? 1u
                                                                           : 0u;
  SCK_L();
  I2C_Delay();
  return ack;
}

/* 总线空闲电平自检:
   F1 系列 GPIO 上下拉仅在输入模式生效, 临时切输入+内部上拉读电平,
   读完恢复开漏输出。开漏输出模式下释放线靠外部上拉, 无外部上拉时
   悬空读数不确定, 会导致 ACK 误判, 本函数可提前暴露接线/供电问题。 */
void SSD1306_BusIdleCheck(uint8_t *sda_high, uint8_t *scl_high)
{
  GPIO_InitTypeDef gp = {0};

  gp.Mode = GPIO_MODE_INPUT;
  gp.Pull = GPIO_PULLUP;
  gp.Speed = GPIO_SPEED_FREQ_LOW;
  gp.Pin = LED_SDA_Pin;
  HAL_GPIO_Init(LED_SDA_GPIO_Port, &gp);
  gp.Pin = LED_SCK_Pin;
  HAL_GPIO_Init(LED_SCK_GPIO_Port, &gp);

  volatile uint32_t i;
  for (i = 0; i < 1000; i++) {
    __NOP(); /*等待电平稳定(内部上拉较弱, RC 较大)*/
  }

  *sda_high =
      (HAL_GPIO_ReadPin(LED_SDA_GPIO_Port, LED_SDA_Pin) == GPIO_PIN_SET);
  *scl_high =
      (HAL_GPIO_ReadPin(LED_SCK_GPIO_Port, LED_SCK_Pin) == GPIO_PIN_SET);

  gp.Mode = GPIO_MODE_OUTPUT_OD;
  gp.Pull = GPIO_NOPULL;
  gp.Pin = LED_SDA_Pin;
  HAL_GPIO_Init(LED_SDA_GPIO_Port, &gp);
  gp.Pin = LED_SCK_Pin;
  HAL_GPIO_Init(LED_SCK_GPIO_Port, &gp);
}

/* 向 SSD1306 写入控制字节 + 命令, 返回 ACK 状态 (0=ACK, 非0=有NACK) */
static uint8_t SSD1306_WriteCommand(uint8_t cmd) {
  uint8_t ack;
  I2C_Start();
  ack = I2C_WriteByte((SSD1306_I2C_ADDR << 1) | 0x00); /* 写地址 */
  ack |= I2C_WriteByte(0x00); /* Co=0, D/C#=0 -> 命令 */
  ack |= I2C_WriteByte(cmd);
  I2C_Stop();
  return ack;
}

uint8_t SSD1306_Init(void) {
  uint8_t err = 0;
  /* 确保引脚为开漏输出 (CubeMX 已配为 OD) */
  err |= SSD1306_WriteCommand(0xAE); /* 关闭显示 */
  err |= SSD1306_WriteCommand(0xD5); /* 时钟分频 */
  err |= SSD1306_WriteCommand(0x80);
  err |= SSD1306_WriteCommand(0xA8); /* 多路复用比 */
  err |= SSD1306_WriteCommand(0x3F); /* 64 */
  err |= SSD1306_WriteCommand(0xD3); /* 显示偏移 */
  err |= SSD1306_WriteCommand(0x00);
  err |= SSD1306_WriteCommand(0x40); /* 起始行 0 */
  err |= SSD1306_WriteCommand(0x8D); /* 电荷泵 */
  err |= SSD1306_WriteCommand(0x14); /* 使能 */
  err |= SSD1306_WriteCommand(0x20); /* 内存寻址模式 */
  err |= SSD1306_WriteCommand(0x00); /* 水平寻址 */
  err |= SSD1306_WriteCommand(0xA1); /* 段重映射 0 */
  err |= SSD1306_WriteCommand(0xC8); /* COM 扫描方向 */
  err |= SSD1306_WriteCommand(0xDA); /* COM 引脚配置 */
  err |= SSD1306_WriteCommand(0x12);
  err |= SSD1306_WriteCommand(0x81); /* 对比度 */
  err |= SSD1306_WriteCommand(0xCF);
  err |= SSD1306_WriteCommand(0xD9); /* 预充电周期 */
  err |= SSD1306_WriteCommand(0xF1);
  err |= SSD1306_WriteCommand(0xDB); /* VCOMH */
  err |= SSD1306_WriteCommand(0x40);
  err |= SSD1306_WriteCommand(0xA4); /* 全屏不点亮 */
  err |= SSD1306_WriteCommand(0xA6); /* 正常显示(非反色) */
  err |= SSD1306_WriteCommand(0xAF); /* 打开显示 */

  SSD1306_Clear();
  SSD1306_UpdateScreen();
  return err;
}

void SSD1306_Clear(void) { memset(s_buffer, 0x00, sizeof(s_buffer)); }

void SSD1306_UpdateScreen(void) {
  /* 设置列地址 0~127, 页地址 0~7 (水平寻址模式下可连续写入) */
  SSD1306_WriteCommand(0x21); /* 设置列地址 */
  SSD1306_WriteCommand(0x00);
  SSD1306_WriteCommand(0x7F);
  SSD1306_WriteCommand(0x22); /* 设置页地址 */
  SSD1306_WriteCommand(0x00);
  SSD1306_WriteCommand(0x07);

  I2C_Start();
  I2C_WriteByte((SSD1306_I2C_ADDR << 1) | 0x00);
  I2C_WriteByte(0x40);
  for (uint16_t i = 0; i < sizeof(s_buffer); i++) {
    I2C_WriteByte(s_buffer[i]);
  }
  I2C_Stop();
}

/* 6x8 ASCII 字体 (0x20~0x7F) */
static const uint8_t s_font6x8[][6] = {
    {0x00, 0x00, 0x00, 0x00, 0x00, 0x00}, /* space */
    {0x00, 0x00, 0x5F, 0x00, 0x00, 0x00}, /* ! */
    {0x00, 0x07, 0x00, 0x07, 0x00, 0x00}, /* " */
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    {0x08, 0x08, 0x2A, 0x1C, 0x08, 0x00}, /* ~ */
};

void SSD1306_DrawChar(uint8_t x, uint8_t y, char ch) {
  if (ch < 0x20 || ch > 0x7E) {
    ch = ' ';
  }
  const uint8_t *glyph = s_font6x8[ch - 0x20];

  if (x + 6 > SSD1306_WIDTH || y + 8 > SSD1306_HEIGHT) {
    return;
  }

  for (uint8_t col = 0; col < 6; col++) {
    uint8_t line = glyph[col];
    for (uint8_t row = 0; row < 8; row++) {
      uint8_t bit = (uint8_t)(1u << ((y + row) % 8));
      uint16_t idx = (uint16_t)((y + row) / 8 * SSD1306_WIDTH + (x + col));
      if (line & (1 << row)) {
        s_buffer[idx] |= bit; /* 点亮 */
      } else {
        s_buffer[idx] &= (uint8_t)~bit; /* 熄灭: 覆盖写入消除残影 */
      }
    }
  }
}

void SSD1306_DrawString(uint8_t x, uint8_t y, const char *str) {
  while (*str) {
    SSD1306_DrawChar(x, y, *str);
    x += 6;
    if (x + 6 > SSD1306_WIDTH) {
      break;
    }
    str++;
  }
}
